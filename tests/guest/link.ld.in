ENTRY(_start)
SECTIONS {
  . = @BASE@;
  .text : { *(.text.start) *(.text .text.*) }
  .rodata : { *(.rodata .rodata.* .srodata*) }
  .data : { *(.data .data.* .sdata*) }
  .bss : { *(.bss .bss.* .sbss* COMMON) }
  . = ALIGN(16);
  . += 0x10000;
  stack_top = .;
}
